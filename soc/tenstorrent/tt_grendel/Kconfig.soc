## soc/tenstorrent/tt_grendel/Kconfig.soc
```kconfig
# Copyright (c) 2025 Tenstorrent AI ULC
# SPDX-License-Identifier: Apache-2.0

config SOC_FAMILY_TT_GRENDEL
	bool

config SOC_FAMILY
	default "tt_grendel" if SOC_FAMILY_TT_GRENDEL

rsource "*/Kconfig.soc"

config SIVAL_SHIM
	bool
	default y if SOC_TT_KERAUNOS_SMC
	help
	  Map SiVal SMC_CPU_* register types to the short names used by
	  shared Grendel drivers.
```

## tests/drivers/memc_tt_mimir/testcase.yaml
```yaml
common:
  build_only: true
  platform_allow:
    - tt_mimir/tt_mimir/smc
  tags:
    - drivers
    - memc
tests:
  drivers.memc_tt_mimir.sim_beh:
    extra_configs:
      - CONFIG_MEMC_TT_MIMIR_ENV_SIM_BEH=y
    extra_args:
      - DTC_OVERLAY_FILE=single_tile.overlay
  drivers.memc_tt_mimir.emu:
    extra_configs:
      - CONFIG_MEMC_TT_MIMIR_ENV_EMU=y
```
