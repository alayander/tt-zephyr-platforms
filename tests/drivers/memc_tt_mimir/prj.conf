## CMakeLists.txt
```
# Copyright (c) 2026 Tenstorrent AI ULC
# SPDX-License-Identifier: Apache-2.0

cmake_minimum_required(VERSION 3.20.0)
find_package(Zephyr REQUIRED HINTS $ENV{ZEPHYR_BASE})

project(memc_tt_mimir)

target_sources(app PRIVATE src/main.c src/chip_init.c src/mimir_gddr_config.c)

set(SIVAL_SDK ${CMAKE_BINARY_DIR}/grendel-sival-sdk/grendel_sival_sdk)

target_include_directories(app PRIVATE
  ${SIVAL_SDK}/common/include
  ${SIVAL_SDK}/common/include/registers
  ${SIVAL_SDK}/common/include/registers/common
  ${SIVAL_SDK}/common/include/registers/mimir
  ${SIVAL_SDK}/common/include/registers/mimir/smc_view
  ${SIVAL_SDK}/firmware/chiplet_config
  ${SIVAL_SDK}/firmware/drivers/addr_remap/include
  ${SIVAL_SDK}/firmware/drivers/firewall/include
  ${SIVAL_SDK}/firmware/drivers/noc/include
  ${SIVAL_SDK}/firmware/drivers/smc/include
  ${SIVAL_SDK}/firmware/libs/basic_init/include
  ${SIVAL_SDK}/firmware/libs/noc/include)

target_sources(app PRIVATE
  ${SIVAL_SDK}/firmware/drivers/firewall/src/firewall.c
  ${SIVAL_SDK}/firmware/drivers/noc/src/itn.c
  ${SIVAL_SDK}/firmware/drivers/smc/src/smc_init.c
  ${SIVAL_SDK}/firmware/libs/basic_init/src/basic_init.c
  ${SIVAL_SDK}/firmware/libs/noc/src/noc_init.c)
```

## Kconfig
```
# Copyright (c) 2026 Tenstorrent AI ULC
# SPDX-License-Identifier: Apache-2.0
#
# Test-only knobs. The memc driver is environment-agnostic -- it takes the GDDR
# fw_params as data -- so the bring-up target is selected here by the test
# harness (mimir_gddr_config.c / chip_init.c / CMakeLists.txt), not by the
# driver.

source "Kconfig.zephyr"

choice MEMC_TT_MIMIR_ENV
	prompt "GDDR bring-up target environment"
	default MEMC_TT_MIMIR_ENV_EMU
	depends on MEMC_TT_MIMIR
	help
	  Selects the execution mode and PHY type the test passes to the GDDR
	  library (fw_params), which chooses the bring-up sequence the library runs.

config MEMC_TT_MIMIR_ENV_EMU
	bool "Emulation (Zebu)"
	help
	  fw_params.exec_mode = EMU.

config MEMC_TT_MIMIR_ENV_SIM_BEH
	bool "RTL simulation, behavioural PHY"
	help
	  fw_params.exec_mode = SIM and gddr_phy_type = BEH.

endchoice
```

## prj.conf
```kconfig
# Copyright (c) 2026 Tenstorrent AI ULC
# SPDX-License-Identifier: Apache-2.0

CONFIG_ZTEST=y

CONFIG_MEMC=y
CONFIG_MEMC_TT_MIMIR=y

CONFIG_ZTEST_TC_UTIL_USER_OVERRIDE=y

CONFIG_FPU=y
CONFIG_FPU_SHARING=y

CONFIG_LOG_MODE_IMMEDIATE=y

CONFIG_BOOT_BANNER=n
CONFIG_TT_BOOT_BANNER=n
```

## single_tile.overlay
```dts
/*
 * Copyright (c) 2026 Tenstorrent AI ULC
 * SPDX-License-Identifier: Apache-2.0
 *
 * Disable the second GDDR tile so the suite exercises the single-tile path:
 * only gddr_tile0 stays status "okay", so the DT-derived gddr_tile_mask covers
 * exactly one tile.
 */

&gddr_tile1 {
	status = "disabled";
};
```

## src/main.c
```c
/*
 * Copyright (c) 2026 Tenstorrent AI ULC
 * SPDX-License-Identifier: Apache-2.0
 *
 * On-target ztest for the Tenstorrent Mimir GDDR7 memc driver. The controller
 * device's init runs the full group bring-up (gddr_init: backend install,
 * param-table load, per-tile init + training), so its readiness is the
 * pass/fail signal for the whole sequence.
 */

#include <zephyr/device.h>
#include <zephyr/devicetree.h>
#include <zephyr/ztest.h>

#define MEMC_NODE DT_NODELABEL(memc)

/*
 * The controller device must have come up: device_is_ready() is false if
 * gddr_init() (device init) or an earlier POST_KERNEL SYS_INIT failed.
 */
ZTEST(memc_tt_mimir, test_bringup)
{
	const struct device *memc = DEVICE_DT_GET(MEMC_NODE);

	zassert_true(device_is_ready(memc),
		     "memc controller not ready: GDDR bring-up (gddr_init) failed");
}

ZTEST_SUITE(memc_tt_mimir, NULL, NULL, NULL, NULL, NULL);
```

## src/chip_init.c
```c
/*
 * Copyright (c) 2026 Tenstorrent AI ULC
 * SPDX-License-Identifier: Apache-2.0
 *
 * Mimir chip init for DV (tt_memc_chip_init): release tile resets, and open the
 * SMC outbound filter + ITN SMN2ITN firewall -- all before the memc driver
 * initializes GDDR.
 */

#include <errno.h>

#include <zephyr/devicetree.h>
#include <zephyr/init.h>
#include <zephyr/sys/sys_io.h>
#include <zephyr/sys/util.h>
#include <zephyr/logging/log.h>

#include <basic_init.h>
#include <itn.h>
#include <noc_init.h>

LOG_MODULE_REGISTER(chip_init, CONFIG_LOG_DEFAULT_LEVEL);

#define RESET_UNIT_SS_RESET_COMPLETE_ADDR 0xC0002060u

/* SMN/ITN plus both CCE and GDDR tiles: everything GDDR bring-up reaches. */
#define COLD_RESET_N_MASK                                                                          \
	((uint32_t)(MIMIR_RST_SMN | MIMIR_RST_ITN | MIMIR_RST_CCE0 | MIMIR_RST_CCE0_DEBUG |        \
		    MIMIR_RST_CCE0_TL1 | MIMIR_RST_CCE1 | MIMIR_RST_CCE1_DEBUG |                   \
		    MIMIR_RST_CCE1_TL1 | MIMIR_RST_D2D0 | MIMIR_RST_D2D1 | MIMIR_RST_GDDR0 |       \
		    MIMIR_RST_GDDR1))

/*
 * Bounded poll budget for reset-release completion; on non-convergence fall
 * back to a fixed NOP settle so bring-up still paces (matches the reference SMC
 * bring-up).
 */
#define RESET_COMPLETE_POLL_MAX 500u
#define RESET_SETTLE_SPIN_ITERS 0x40u

#define SMC_OUTBOUND_FILTER_CTRL_0_CONFIG 0xC0016000u
#define SMC_OUTBOUND_FILTER_CTRL_1_CONFIG 0xC0016020u
#define SMC_OUTBOUND_FILTER_CTRL_2_CONFIG 0xC0016040u
#define SMC_OUTBOUND_FILTER_CTRL_3_CONFIG 0xC0016060u
#define FILTER_CONFIG_OPEN                0x01000103u

/* FW-handshake scratch regs */
#define SMC_CTRL_SCRATCH_07_ADDR 0xC0010138u /* firewall window    */
#define SMC_CTRL_SCRATCH_09_ADDR 0xC0010148u /* boot handshake     */
#define SMC_CTRL_SCRATCH_14_ADDR 0xC0010170u /* memory_capacity_gb */
#define SMC_CTRL_SCRATCH_15_ADDR 0xC0010178u /* interleave_mode    */

#define SCRATCH07_FW_START_GB(v)        ((uint64_t)((v) & 0x7Fu))        /* [6:0]   */
#define SCRATCH07_FW_END_GB(v)          ((uint64_t)(((v) >> 7) & 0x7Fu)) /* [13:7]  */
#define SCRATCH15_INTERLEAVE_MODE(v)    (((v) >> 2) & 0x7u)              /* [4:2]   */
#define SCRATCH14_MEMORY_CAPACITY_GB(v) (((v) >> 13) & 0x1Fu)            /* [17:13] */

/* SCRATCH_09 boot-handshake bits the mimir_soc harness polls. */
#define SCRATCH9_FIREWALL_SETUP_DONE BIT(0)
#define SCRATCH9_NOC2AXI_SETUP_DONE  BIT(2)

#define FW_SLOT15_OFFSET 0x1E0u

/* FILTER_CONFIG (smc_cpu_reg.h FILTER_CTRL_FILTER_CONFIG):
 *   read_en[0] write_en[1] addr_mode[4] allow_ns[8] data_bus_width[14:12]
 *   src_id[19:16] group_id[23:20] allow_burst[24]. Reference sets dbw=7,
 *   burst=1, addr_mode=1, r/w=1, src_id/group_id=0.
 */
#define FW_CFG_BASE     (0x1u | 0x2u | 0x10u | 0x7000u | 0x1000000u)
#define FW_CFG_ALLOW_NS (FW_CFG_BASE | 0x100u) /* allow_ns=1 -> 0x01007113 */
#define FW_CFG_SECURE   (FW_CFG_BASE)          /* allow_ns=0 -> 0x01007013 */

/* END_ADDR/START_ADDR are 56-bit fields; full-open end. */
#define FW_ADDR_FULL_OPEN 0x00FFFFFFFFFFFFFFULL

/* Program one firewall filter slot: FILTER_CONFIG, START_ADDR, END_ADDR. */
static inline void fw_prog_slot(uint32_t cfg_addr, uint64_t cfg, uint64_t start, uint64_t end)
{
	sys_write64(cfg, cfg_addr);
	sys_write64(start, cfg_addr + 0x8u);
	sys_write64(end, cfg_addr + 0x10u);
}

/*
 * Program a tile's FIREWALL_0 (allow_ns) and FIREWALL_15 (secure) with a
 * window, mirroring firmware disable_firewall_filters(). Used for both the SMC
 * outbound filter and the ITN tiles.
 */
static inline void fw_prog_tile(uint32_t base, uint64_t start, uint64_t end)
{
	fw_prog_slot(base, FW_CFG_ALLOW_NS, start, end);
	fw_prog_slot(base + FW_SLOT15_OFFSET, FW_CFG_SECURE, start, end);
}

/*
 * Open one mem-tiles entry's ITN firewall windows: MEM tile to the GDDR window
 * (mem_start/mem_end, from the enclosing function), CCE and CCE_CFG full-open.
 */
#define TILE_PROG_FW(node_id, prop, idx)                                                           \
	fw_prog_tile(DT_PROP_BY_PHANDLE_IDX(node_id, prop, idx, mem_filter_base), mem_start,       \
		     mem_end);                                                                     \
	fw_prog_tile(DT_PROP_BY_PHANDLE_IDX(node_id, prop, idx, cce_filter_base), 0x0ULL,          \
		     FW_ADDR_FULL_OPEN);                                                           \
	fw_prog_tile(DT_PROP_BY_PHANDLE_IDX(node_id, prop, idx, cce_cfg_filter_base), 0x0ULL,      \
		     FW_ADDR_FULL_OPEN);

/*
 * Wait until the SMC reset unit reports the domains we just released as
 * complete, before touching SMN/ITN/CCE/GDDR.
 */
static void wait_reset_release_complete(uint32_t mask)
{
	for (uint32_t i = 0; i < RESET_COMPLETE_POLL_MAX; i++) {
		if ((sys_read32(RESET_UNIT_SS_RESET_COMPLETE_ADDR) & mask) == mask) {
			return;
		}
	}

	LOG_WRN("reset-complete did not converge (mask=0x%08x status=0x%08x); "
		"using fixed settle",
		mask, sys_read32(RESET_UNIT_SS_RESET_COMPLETE_ADDR));

	for (volatile uint32_t i = 0; i < RESET_SETTLE_SPIN_ITERS; i++) {
		__asm__ volatile("nop");
	}
}

static int tt_memc_chip_init(void)
{
	/* 1) Release cold+warm reset for SMN/ITN/CCE/GDDR. */
	smc_release_reset(COLD_RESET_N_MASK);
	wait_reset_release_complete(COLD_RESET_N_MASK);

	/*
	 * 2) Open the SMC outbound filter so SoC-space (ITN, GDDR ctrl/PHY) is
	 * reachable. Config-only open on CTRL_0..3 (reference
	 * setup_smc_outbound_filter()).
	 */
	sys_write64(FILTER_CONFIG_OPEN, SMC_OUTBOUND_FILTER_CTRL_0_CONFIG);
	sys_write64(FILTER_CONFIG_OPEN, SMC_OUTBOUND_FILTER_CTRL_1_CONFIG);
	sys_write64(FILTER_CONFIG_OPEN, SMC_OUTBOUND_FILTER_CTRL_2_CONFIG);
	sys_write64(FILTER_CONFIG_OPEN, SMC_OUTBOUND_FILTER_CTRL_3_CONFIG);

	/* 3) Open the ITN SMN2ITN firewall windows. */
	uint32_t s07 = sys_read32(SMC_CTRL_SCRATCH_07_ADDR);
	uint64_t mem_start = SCRATCH07_FW_START_GB(s07) << 30;
	uint64_t mem_end = (SCRATCH07_FW_END_GB(s07) << 30) - 1ULL;
	uint32_t s15 = sys_read32(SMC_CTRL_SCRATCH_15_ADDR);
	uint32_t s14 = sys_read32(SMC_CTRL_SCRATCH_14_ADDR);
	uint32_t interleave_mode = SCRATCH15_INTERLEAVE_MODE(s15);
	uint32_t memory_capacity_gb = SCRATCH14_MEMORY_CAPACITY_GB(s14);

	DT_FOREACH_PROP_ELEM(DT_NODELABEL(memc), mem_tiles, TILE_PROG_FW)

	/* 4) Program ITN interleave mode + GDDR capacity. */
	grendel_err_t err = noc_init_interleave_cfg((noc_interleave_mode_t)interleave_mode);

	if (err != GRENDEL_ERR_OK) {
		LOG_ERR("ITN interleave mode %u rejected: %d", interleave_mode, (int)err);
		return -EINVAL;
	}

	itn_gddr7_memory_address_realignment_cfg((noc_gddr7_realign_t)memory_capacity_gb);

	LOG_INF("Mimir chip init: resets released, outbound filter open, ITN "
		"firewall win[0x%llx..0x%llx], interleave=%u capacity_gb=%u",
		(unsigned long long)mem_start, (unsigned long long)mem_end, interleave_mode,
		memory_capacity_gb);

	/* 5) DV firewall / noc2axi boot handshake. */
	uint32_t s09 = sys_read32(SMC_CTRL_SCRATCH_09_ADDR);

	sys_write32(s09 | SCRATCH9_FIREWALL_SETUP_DONE | SCRATCH9_NOC2AXI_SETUP_DONE,
		    SMC_CTRL_SCRATCH_09_ADDR);
	LOG_INF("DV handshake: asserted SCRATCH_9 firewall/noc2axi setup done");

	return 0;
}

SYS_INIT(tt_memc_chip_init, POST_KERNEL, 0);
```

## src/mimir_gddr_config.c
```c
/*
 * Copyright (c) 2026 Tenstorrent AI ULC
 * SPDX-License-Identifier: Apache-2.0
 *
 * DV stand-in providing the GDDR configuration the memc driver consumes. It
 * builds the fw_params table, selects the backend, and installs fw_params +
 * backend into the memc device via memc_tt_mimir_set_config() before it inits.
 */

#include <string.h>

#include <zephyr/drivers/memc/memc_tt_mimir.h>
#include <zephyr/device.h>
#include <zephyr/devicetree.h>
#include <zephyr/init.h>
#include <zephyr/logging/log.h>
#include <zephyr/sys/util.h>
#include <zephyr/toolchain.h>

LOG_MODULE_REGISTER(mimir_gddr_config, CONFIG_LOG_DEFAULT_LEVEL);

#define MIMIR_GDDR_CONFIG_INIT_PRIORITY 80
BUILD_ASSERT(MIMIR_GDDR_CONFIG_INIT_PRIORITY < CONFIG_MEMC_TT_MIMIR_INIT_PRIORITY,
	     "GDDR config must initialize before the memc controller device");

static fw_params_t mimir_fw_params_storage;

static grendel_err_t stub_get_blob(void *ctx, gddr_blob_id_e id, void *dst, size_t dst_cap,
				   size_t *out_len)
{
	ARG_UNUSED(ctx);
	ARG_UNUSED(dst);
	ARG_UNUSED(dst_cap);

	if (out_len != NULL) {
		*out_len = 0;
	}

	LOG_ERR("get_blob(id=%d) requested but no blob source is wired (EMU expects none)",
		(int)id);
	return GRENDEL_ERR_GDDR7_NOT_SUPPORTED;
}

/* EMU backend: no blob source (EMU expects no blobs). */
static const gddr_backend_t mimir_gddr_backend = {
	.get_blob = stub_get_blob,
	.load_phy_fw = NULL,
	.load_phy_regconfig = NULL,
	.phy_prog_done = NULL,
	.ctx = NULL,
};

static int mimir_gddr_configure(void)
{
	fw_params_t *fp = &mimir_fw_params_storage;
	gddr_fw_params_t *g = &fp->chiplet.mimir_smc.gddr;
	const gddr_backend_t *backend;

	memset(fp, 0, sizeof(*fp));
	fp->magic = FW_PARAMS_MAGIC;
	fp->version = FW_PARAMS_VERSION;
	fp->platform = FW_PARAMS_PLATFORM_MIMIR_SMC;
	fp->chiplet_id = 0;

	for (size_t i = 0; i < ARRAY_SIZE(g->gddr_fsp); i++) {
		gddr_fsp_params_t *fsp = &g->gddr_fsp[i];

		fsp->gddr_ca_lvl_train = GDDR_OVERRIDE_INHERIT;
		fsp->gddr_ca_vref_train = GDDR_OVERRIDE_INHERIT;
		fsp->gddr_err_lvl_train = GDDR_OVERRIDE_INHERIT;
		fsp->gddr_rd_lvl_mode = GDDR_LVL_MODE_INHERIT;
		fsp->gddr_rd_coarse_vref_train = GDDR_OVERRIDE_INHERIT;
		fsp->gddr_rd_fine_vref_train = GDDR_OVERRIDE_INHERIT;
		fsp->gddr_rd_dfe_train = GDDR_OVERRIDE_INHERIT;
		fsp->gddr_rd_ctle_train = GDDR_OVERRIDE_INHERIT;
		fsp->gddr_wr_lvl_mode = GDDR_LVL_MODE_INHERIT;
		fsp->gddr_wr_vref_train = GDDR_OVERRIDE_INHERIT;
		fsp->gddr_wr_dfe_train = GDDR_OVERRIDE_INHERIT;
		fsp->gddr_ovr_rl = (uint32_t)GDDR_OVERRIDE_INHERIT;
		fsp->gddr_ovr_wl = (uint32_t)GDDR_OVERRIDE_INHERIT;
		fsp->gddr_ovr_crcrl = (uint32_t)GDDR_OVERRIDE_INHERIT;
		fsp->gddr_ovr_crcwl = (uint32_t)GDDR_OVERRIDE_INHERIT;
		fsp->gddr_ovr_capar_err_latency = (uint32_t)GDDR_OVERRIDE_INHERIT;
		fsp->gddr_ovr_rck_mode = (uint32_t)GDDR_OVERRIDE_INHERIT;
		fsp->gddr_ovr_rddata_en_ctrl_delta = (uint32_t)GDDR_OVERRIDE_INHERIT;
	}

	g->gddr_ovr_crc_en = GDDR_OVERRIDE_INHERIT;
	g->gddr_ovr_cabi_en = GDDR_OVERRIDE_INHERIT;
	g->gddr_ovr_capar_en = GDDR_OVERRIDE_INHERIT;
	g->gddr_ovr_bg_interleave = GDDR_OVERRIDE_INHERIT;
	g->gddr_ovr_reorder_en = GDDR_OVERRIDE_INHERIT;
	g->gddr_ovr_clamshell = GDDR_OVERRIDE_INHERIT;
	g->gddr_ovr_phy_wrlat_ctrl_delta = (uint32_t)GDDR_OVERRIDE_INHERIT;

#if defined(CONFIG_MEMC_TT_MIMIR_ENV_SIM_BEH)
	fp->exec_mode = FW_PARAMS_EXEC_MODE_SIM;
	g->gddr_phy_type = GDDR_PHY_TYPE_BEH;
#else
	fp->exec_mode = FW_PARAMS_EXEC_MODE_EMU;
	g->gddr_phy_type = GDDR_PHY_TYPE_BEH;
#endif
	fp->chiplet.mimir_smc.common.channel_capacity = GDDR_CHANNEL_DENSITY_1_GB;
	g->gddr_vendor = GDDR_VENDOR_AVERY_SIM;
	g->gddr_num_fsp_en = 1;
	g->gddr_fsp[0].gddr_freq = 32;
	g->gddr_fsp[0].gddr_phy_train_en = GDDR_ENABLE;
	g->gddr_ctrl_config_method = GDDR_CTRL_CONFIG_METHOD_COMPILED;

	backend = &mimir_gddr_backend;

	return memc_tt_mimir_set_config(DEVICE_DT_GET(DT_NODELABEL(memc)), backend, fp);
}

SYS_INIT(mimir_gddr_configure, POST_KERNEL, MIMIR_GDDR_CONFIG_INIT_PRIORITY);
```
